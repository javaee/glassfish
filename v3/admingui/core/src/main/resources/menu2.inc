                <sc:subMenu value="Edit">
                    <sc:subMenu value="Applications">
                        <sc:menuItem value="Enterprise Applications"/>
                        <sc:menuItem value="Web Applications"/>
                        <sc:menuItem value="EJB Modules"/>
                        <sc:menuItem value="Lifecycle Modules"/>
                        <sc:menuItem value="Application Client Modules"/>
                    </sc:subMenu>
                    <sc:subMenu value="Application Server">
                        <sc:menuItem value="JVM Settings"/>
                        <sc:menuItem value="Logger Settings"/>
                        <sc:menuItem value="Thread Pools"/>
                    </sc:subMenu>
                    <sc:subMenu value="Service">
                        <sc:menuItem value="Web Container"/>
                        <sc:menuItem value="EJB Container"/>
                        <sc:menuItem value="JMS"/>
                        <sc:menuItem value="Availability Service"/>
                        <sc:menuItem value="Transaction Service"/>
                        <sc:menuItem value="Admin Service"/>
                        <sc:menuItem value="Connector Service"/>
                        <sc:menuItem value="Diagnostic Service"/>
                        <sc:subMenu value="Security">
                            <sc:menuItem value="Realm"/>
                            <sc:menuItem value="JACC Provider"/>
                            <sc:menuItem value="Thread Pools"/>
                        </sc:subMenu>
                        <sc:subMenu value="HTTP Service">
                            <sc:menuItem value="HTTP Listeners"/>
                            <sc:menuItem value="Virtual Servers"/>
                        </sc:subMenu>
                        <sc:subMenu value="Object Request Broker">
                            <sc:menuItem value="IIOP Listeners"/>
                        </sc:subMenu>
                    </sc:subMenu>
                    <sc:menuItem value="Clusters"/>
                    <sc:menuItem value="Management Rules"/>
                    <sc:menuItem value="Web Services"/>
                    <sc:menuItem value="HTTP Load Balancers"/>
                    <sc:menuItem value="Stand-Alone Instances"/>
                    <sc:menuItem value="Node Agent References"/>
                    <sc:subMenu value="JBI">
                        <sc:menuItem value="Service Assemblies"/>
                        <sc:menuItem value="Components"/>
                        <sc:menuItem value="Shared Libraries"/>
                    </sc:subMenu>
                    <sc:menuItem value="Configuration System Properties"/>
                    <sc:menuItem value="Custom MBeans"/>
                    <sc:subMenu value="Resources">
                        <sc:menuItem value="JDBC Resources"/>
                        <sc:menuItem value="JDBC Connection Pools"/>
                        <sc:menuItem value="JMS Connection Factories"/>
                        <sc:menuItem value="JMS Destination Resources"/>
                        <sc:menuItem value="JavaMail Sessions"/>
                        <sc:menuItem value="JNDI Custom Resources"/>
                        <sc:menuItem value="JNDI External Resources"/>
                        <sc:subMenu value="Connectors">
                            <sc:menuItem value="Connector Resources"/>
                            <sc:menuItem value="Connection Pools"/>
                            <sc:menuItem value="Admin Object Resources"/>
                        </sc:subMenu>
                    </sc:subMenu>
                </sc:subMenu>
                <sc:subMenu value="View">
                    <sc:menuItem value="Site Map"/>
                    <sc:menuItem value="Bookmarkable URL"/>
                </sc:subMenu>
                <sc:subMenu value="Tools">
                    <sc:menuItem value="Performance Advisor"/>
                    <sc:menuItem value="User Settings"/>
                    <sc:menuItem value="Update Center"/>
                </sc:subMenu>
                <sc:subMenu value="Monitor">
                    <sc:menuItem value="Configure Monitoring"/>
                    <sc:menuItem value="Web Service"/>
                    <sc:menuItem value="Call Flow"/>
                    <sc:menuItem value="Dashboard"/>
                </sc:subMenu>
                <sc:subMenu value="Bookmarks">
                    <sc:menuItem value="Bookmark This Page"/>
                    <sc:menuItem value="Manage Bookmarks"/>
                    <sc:menuItem value="Common Tasks Page"/>
                </sc:subMenu>
                <sc:subMenu value="Help">
                    <sc:menuItem value="Online Help"/>
                    <sc:menuItem value="Support"/>
                    <sc:menuItem value="Forums"/>
                    <sc:menuItem value="Report a Problem"/>
                    <sc:menuItem value="Register"/>
                    <sc:menuItem value="About Plugins..."/>
                    <sc:menuItem value="About..."/>
                </sc:subMenu>