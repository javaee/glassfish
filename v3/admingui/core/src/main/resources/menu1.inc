
<sc:subMenu value="Deploy" id="deployMenu">
<sc:menuItem value="Enterprise Application" url="#" />
<sc:menuItem value="Web Application" url="#" />
<sc:menuItem value="EJB Module" url="#" />
<sc:menuItem value="Connector Module" url="#" />
<sc:menuItem value="Lifecycle Module" url="#" />
<sc:menuItem value="App Client Module" url="#" />
<sc:menuItem value="Custom MBean" url="#" />

<sc:subMenu value="JBI" id="jbiMenu">
<sc:menuItem value="Component" url="#" />
<sc:menuItem value="Shared Library" url="#" />
</sc:subMenu>

</sc:subMenu>

<sc:subMenu value="Create" id="createMenu">
<sc:menuItem value="JDBC Resource" url="#" />
<sc:menuItem value="JDBC Connection Pool" url="#" />

<sc:subMenu value="JMS" id="jmsMenu">
<sc:menuItem value="JMS Connection Factory" url="#" />
<sc:menuItem value="JMS Destination Resource" url="#" />
<sc:menuItem value="JMS Host" url="#" />
<sc:menuItem value="JMS Physical Destination" url="#" />
</sc:subMenu>

<sc:menuItem value="JavaMail Session" url="#" />
<sc:menuItem value="JNDI Custom Resource" url="#" />
<sc:menuItem value="JNDI External Resource" url="#" />

<sc:subMenu value="Connectors" id="connectorsMenu">
<sc:menuItem value="Connection Resource" url="#" />
<sc:menuItem value="Connection Pool" url="#" />
<sc:menuItem value="Admin Object Resource" url="#" />
</sc:subMenu>

<sc:subMenu value="Security" id="securityMenu">
<sc:menuItem value="Realm" url="#" />
<sc:menuItem value="JACC Provider" url="#" />
<sc:menuItem value="Audit Module" url="#" />
<sc:menuItem value="Message Security Configuration" url="#" />
</sc:subMenu>

<sc:menuItem value="HTTP Listener" url="#" />
<sc:menuItem value="Virtual Server" url="#" />
<sc:menuItem value="IIOP Listener" url="#" />
<sc:menuItem value="Thread Pool" url="#" />
<sc:menuItem value="Management Rule" url="#" />
<sc:menuItem value="Node Agent Reference" url="#" />
<sc:menuItem value="Cluster" url="#" />
<sc:menuItem value="HTTP Load Balancer" url="#" />
</sc:subMenu>
